## boards/shields/xpander_xiao/Kconfig.defconfig
```kconfig
if SHIELD_XPANDER_XIAO

config ZMK_KEYBOARD_NAME
    default "ZMK Xpander"

config ZMK_BLE
    def_bool n

config SETTINGS
    def_bool n

# Enable I2C
config I2C
    default y

endif
```
